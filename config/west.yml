## config/west.yml
```yaml
manifest:
  remotes:
    - name: timstewartj
      url-base: https://github.com/timstewartj
  projects:
    - name: zmk
      remote: timstewartj
      revision: 168deda1d13c56524c2c4ba4da7c934c242072f6
      import: app/west.yml
  self:
    path: config
```
